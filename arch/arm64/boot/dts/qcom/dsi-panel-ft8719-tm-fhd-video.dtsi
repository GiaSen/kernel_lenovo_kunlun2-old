/* Copyright (c) 2017, The Linux Foundation. All rights reserved.
 *
 * This program is free software; you can redistribute it and/or modify
 * it under the terms of the GNU General Public License version 2 and
 * only version 2 as published by the Free Software Foundation.
 *
 * This program is distributed in the hope that it will be useful,
 * but WITHOUT ANY WARRANTY; without even the implied warranty of
 * MERCHANTABILITY or FITNESS FOR A PARTICULAR PURPOSE.  See the
 * GNU General Public License for more details.
 */

&mdss_mdp {
	dsi_ft8719_tm_fhd_video: qcom,mdss_dsi_ft8719_tm_fhd_video {
		qcom,mdss-dsi-panel-name =
				"ft8719 tm fhd video mode dsi panel";
		qcom,mdss-dsi-panel-type = "dsi_video_mode";
		qcom,mdss-dsi-virtual-channel-id = <0>;
		qcom,mdss-dsi-stream = <0>;
		qcom,mdss-dsi-bpp = <24>;
		qcom,mdss-dsi-underflow-color = <0xff>;
		qcom,mdss-dsi-border-color = <0>;
		qcom,mdss-dsi-traffic-mode = "burst_mode";
		qcom,mdss-dsi-bllp-eof-power-mode;
		qcom,mdss-dsi-bllp-power-mode;
		qcom,mdss-dsi-lane-0-state;
		qcom,mdss-dsi-lane-1-state;
		qcom,mdss-dsi-lane-2-state;
		qcom,mdss-dsi-lane-3-state;
		qcom,mdss-dsi-dma-trigger = "trigger_sw";
		qcom,mdss-dsi-mdp-trigger = "none";
		qcom,mdss-dsi-reset-sequence = <1 10>, <0 10>, <1 10>;
		qcom,mdss-dsi-tx-eot-append;
		qcom,mdss-dsi-post-init-delay = <1>;

		qcom,panel-supply-entries = <&dsi_panel_pwr_supply>;
		qcom,mdss-dsi-bl-pmic-control-type = "bl_ctrl_wled";
		qcom,mdss-dsi-bl-min-level = <1>;
		qcom,mdss-dsi-bl-max-level = <4095>;
		qcom,mdss-brightness-max-level = <4095>;
		qcom,mdss-dsi-mode-sel-gpio-state = "single_port";
		qcom,platform-reset-gpio = <&tlmm 75 0>;
		qcom,platform-te-gpio = <&tlmm 10 0>;

		qcom,mdss-dsi-min-refresh-rate = <55>;
		qcom,mdss-dsi-max-refresh-rate = <60>;
		qcom,mdss-dsi-pan-enable-dynamic-fps;
		qcom,mdss-dsi-pan-fps-update = "dfps_immediate_porch_mode_vfp";

		qcom,esd-check-enabled;
		qcom,mdss-dsi-panel-status-check-mode = "reg_read";
		qcom,mdss-dsi-panel-status-command = [06 01 00 01 00 00 01 0A
					06 01 00 01 00 00 01 0C
					06 01 00 01 05 00 01 0D];
		qcom,mdss-dsi-panel-status-command-state = "dsi_hs_mode";
		qcom,mdss-dsi-panel-status-value = <0x9c>,< 0x07>,<0x00>;
		qcom,mdss-dsi-panel-status-valid-params = <1 1 1>;
		qcom,mdss-dsi-panel-status-read-length = <1 1 1>;

		qcom,mdss-dsi-t-clk-post = <0x0E>;
		qcom,mdss-dsi-t-clk-pre = <0x34>;
		qcom,mdss-dsi-display-timings {
			timing@0{
				qcom,mdss-dsi-panel-width = <1080>;
				qcom,mdss-dsi-panel-height = <2340>;
				qcom,mdss-dsi-h-front-porch = <26>;
				qcom,mdss-dsi-h-back-porch = <16>;
				qcom,mdss-dsi-h-pulse-width = <4>;
				qcom,mdss-dsi-h-sync-skew = <0>;
				qcom,mdss-dsi-h-sync-pulse = <0>;
				qcom,mdss-dsi-v-back-porch = <12>;
				qcom,mdss-dsi-v-front-porch = <120>;
				qcom,mdss-dsi-v-pulse-width = <4>;
				qcom,mdss-dsi-panel-framerate = <60>;
				qcom,mdss-dsi-h-left-border = <0>;
				qcom,mdss-dsi-h-right-border = <0>;
				qcom,mdss-dsi-v-top-border = <0>;
				qcom,mdss-dsi-v-bottom-border = <0>;

				qcom,mdss-dsi-panel-phy-timings = [00 22 08 09 25 23 09 09 06 03 04 00];
				qcom,display-topology = <1 0 1>;
				qcom,default-topology-index = <0>;

				qcom,mdss-dsi-on-command =[
					39 01 00 00 00 00 02 00 00
					39 01 00 00 00 00 04 FF 87 19 01
					39 01 00 00 00 00 02 00 80
					39 01 00 00 00 00 03 FF 87 19//cmd2 enable
					39 01 00 00 00 00 02 00 C0
					39 01 00 00 00 00 02 C5 11
					39 01 00 00 00 00 02 00 AE
					39 01 00 00 00 00 03 C1 88 88
					39 01 00 00 00 00 02 00 00
					39 01 00 00 00 00 04 FF 00 00 00
					39 01 00 00 00 00 02 00 80
					39 01 00 00 00 00 03 FF 00 00 //CMD2 Disable
					39 01 00 00 00 00 02 00 00
					39 01 00 00 00 00 03 99 95 27
					15 01 00 00 00 00 02 35 00
					15 01 00 00 78 00 02 11 00
					15 01 00 00 14 00 02 29 00
					39 01 00 00 00 00 02 00 00
					39 01 00 00 00 00 03 99 00 00];
				qcom,mdss-dsi-off-command = [39 01 00 00 00 00 02 00 00
					39 01 00 00 00 00 03 99 95 27
					15 01 00 00 32 00 02 28 00
					15 01 00 00 78 00 02 10 00
					39 01 00 00 00 00 02 00 00
					39 01 00 00 00 00 05 F7 5A A5 95 27
					39 01 00 00 00 00 02 00 00
					39 01 00 00 00 00 03 99 00 00
					39 01 00 00 00 00 02 00 00
					39 01 00 00 00 00 04 FF 87 19 01
					39 01 00 00 00 00 02 00 80
					39 01 00 00 00 00 03 FF 87 19 //cmd2 enable
					39 01 00 00 00 00 02 00 00
					39 01 00 00 00 00 04 FF 00 00 00];
				qcom,mdss-dsi-on-command-state = "dsi_lp_mode";
				qcom,mdss-dsi-off-command-state = "dsi_lp_mode";
				qcom,mdss-dsi-panel-timings = [e6 38 26 00
					68 6e 2a 3c 44 03 04 00];
			};
		};
	};
};
