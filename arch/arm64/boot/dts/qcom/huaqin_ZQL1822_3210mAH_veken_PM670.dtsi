
qcom,3696294_huaqin_ql1822_3300mah_averaged_masterslave_oct9th2018 {
	qcom, = <24>;
	/* #3696294_Huaqin_QL1822_3300mAh_averaged_MasterSlave_Oct9th2018*/
	qcom,max-voltage-uv = <4400000>;
	qcom,nom-batt-capacity-mah = <3300>;
	qcom,batt-id-kohm = <100>;
	qcom,battery-beta = <3435>;
	qcom,fg-cc-cv-threshold-mv = <4390>;
	/* Huaqin modify for JD2019-166 Config JEITA according to battery by gaochao at 2018/09/05 start */
	/* Huaqin modify for JD2019-HQ000003 Set FCC as 2750mA to optimize thermal and batery by gaochao at 2018/09/24 start */
	qcom,fastchg-current-ma = <2600>;
	qcom,jeita-fcc-ranges = <0   150   660000
				 151 450  2600000
				 451 500  1650000>;
	qcom,jeita-fv-ranges =  <0   150  4400000
				 151 450  4400000
				 451 500  4100000>;

	qcom,step-chg-ranges = <3400000  4200000  2600000
                               4201000  4400000  2000000>;
	/* Huaqin modify for JD2019-HQ000003 Set FCC as 2750mA to optimize thermal and battery by gaochao at 2018/09/24 end */
	/* Huaqin modify for JD2019-166 Config JEITA according to battery by gaochao at 2018/09/05 end */
	qcom,battery-type = "3696294_huaqin_ql1822_3300mah_averaged_masterslave_oct9th2018";
	qcom,checksum = <0x869F>;
	qcom,gui-version = "PM660GUI - 0.0.0.45";
	qcom,fg-profile-data = [
		 37 20 D7 04
		 0F 0B C0 05
		 ED 1C C0 01
		 56 04 20 0A
		 D2 17 9D 23
		 C9 44 E9 53
		 80 00 00 00
		 11 00 00 00
		 00 00 23 C4
		 F1 CD 34 C3
		 1E 00 08 00
		 94 E2 CE ED
		 1E F4 63 00
		 64 01 2E 12
		 E9 04 2C 2B
		 18 06 09 20
		 27 00 14 00
		 C3 1F 80 05
		 96 0A 53 FC
		 CA 1C EF 02
		 FC 15 3C 12
		 8E 18 D1 23
		 E9 4D 2B 5B
		 69 00 00 00
		 0E 00 00 00
		 00 00 2D CC
		 0C C3 F9 B2
		 1B 00 00 00
		 1C EB CE ED
		 BE F4 25 EA
		 37 DD 6E 03
		 20 BB A7 1A
		 B4 33 CC FF
		 07 10 00 00
		 E3 0C 66 46
		 1B 00 40 00
		 8B 01 0A FA
		 FF 00 00 00
		 00 00 00 00
		 00 00 00 00
		 00 00 00 00
		 00 00 00 00
		 00 00 00 00
		 00 00 00 00
		 00 00 00 00
		 00 00 00 00
		 00 00 00 00
		 00 00 00 00
		 00 00 00 00
		 00 00 00 00
		 00 00 00 00
		 00 00 00 00
		 00 00 00 00
		 00 00 00 00
		 00 00 00 00
		 00 00 00 00
	];
};

